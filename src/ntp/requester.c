/**
 * Networking basics used in this file - generated by ChatGPT-5:
 * - AF_INET            : Address family for IPv4 sockets.
 * - SOCK_DGRAM         : Datagram (connectionless) sockets, used for UDP.
 * - IPPROTO_UDP        : Protocol value for UDP.
 * - struct sockaddr_in : IPv4 socket address (IP + port).
 * - getaddrinfo        : Resolves a hostname + service/port to socket addresses.
 * - sendto             : Sends a UDP datagram to a destination address.
 * - recvfrom           : Receives a UDP datagram (waits up to SO_RCVTIMEO timeout).
 */

#include <string.h>
#include <sys/socket.h>
#include <netdb.h>
#include <arpa/inet.h>
#include <unistd.h>
#include <time.h>

#include "esp_log.h"

#define NTP_LI_NO_WARNING   0  // no leap second
#define NTP_VN_4  4 // Version number (Last -> (RFC 5905))
#define NTP_MODE_CLIENT    3

#define NTP_LI_SHIFT    6
#define NTP_VN_SHIFT    3

#define NTP_TASK_TAG "NTP_REQ"

#define NTP_PORT        123
#define NTP_PACKET_LEN  48
#define NTP_UNIX_OFFSET 2208988800UL

#define MAX_SNTP_SERVERS       3
#define SNTP_MAX_HOSTNAME_LEN  64

static char s_servernames[MAX_SNTP_SERVERS][SNTP_MAX_HOSTNAME_LEN];

#define SYNC_OK_INTERVAL_MS     (60 * 60 * 1000)
#define SYNC_FAIL_INTERVAL_MS   (1  * 60 * 1000)

// NTP packet format
typedef struct {
    uint8_t  li_vn_mode;
    uint8_t  stratum;
    uint8_t  poll;
    int8_t   precision;
    uint32_t root_delay;
    uint32_t root_dispersion;
    uint32_t ref_id;
    uint32_t ref_ts_sec;
    uint32_t ref_ts_frac;
    uint32_t orig_ts_sec;
    uint32_t orig_ts_frac;
    uint32_t recv_ts_sec;
    uint32_t recv_ts_frac;
    uint32_t tx_ts_sec;
    uint32_t tx_ts_frac;
} ntp_packet_t;

static esp_err_t sntp_resolve_hostname(const char *hostname, struct sockaddr_in *out_addr)
{
    struct addrinfo hints = {
        .ai_family = AF_INET,
        .ai_socktype = SOCK_DGRAM,
        .ai_protocol = IPPROTO_UDP,
    };
    struct addrinfo *res = NULL;

    int err = getaddrinfo(hostname, "123", &hints, &res);
    if (err != 0 || res == NULL) {
        ESP_LOGE(NTP_TASK_TAG, "DNS lookup failed for hostname %s", hostname);
        if (res) {
            freeaddrinfo(res);
        }
        return ESP_FAIL;
    }

    struct sockaddr_in *addr4 = (struct sockaddr_in *)res->ai_addr;

    out_addr->sin_family = AF_INET;
    out_addr->sin_port = htons(NTP_PORT);
    out_addr->sin_addr = addr4->sin_addr;

    freeaddrinfo(res);
    return ESP_OK;
}

static void sntp_init_packet(ntp_packet_t *packet)
{
    *packet = (ntp_packet_t){0};
    packet->li_vn_mode =
        (NTP_LI_NO_WARNING << NTP_LI_SHIFT) |
        (NTP_VN_4 << NTP_VN_SHIFT) |
        (NTP_MODE_CLIENT);
}

static esp_err_t sntp_send_and_receive(int sock, const struct sockaddr_in *addr, ntp_packet_t *packet)
{
    if (sendto(sock, packet, sizeof(*packet), 0,
               (const struct sockaddr *)addr, sizeof(*addr)) < 0) {
        ESP_LOGE(NTP_TASK_TAG, "Send failed");
        return ESP_FAIL;
    }

    if (recvfrom(sock, packet, sizeof(*packet), 0, NULL, NULL) < 0) {
        ESP_LOGE(NTP_TASK_TAG, "No response");
        return ESP_FAIL;
    }

    return ESP_OK;
}

void setservername_sntp(uint8_t index, const char *hostname)
{
    if (index >= MAX_SNTP_SERVERS || hostname == NULL) {
        return;
    }
    strncpy(s_servernames[index], hostname, SNTP_MAX_HOSTNAME_LEN - 1);
    s_servernames[index][SNTP_MAX_HOSTNAME_LEN - 1] = '\0';
}

static esp_err_t sntp_request_one(const char *hostname)
{
    int sock = -1;
    struct sockaddr_in addr;
    ntp_packet_t packet;

    struct timeval timeout = {
        .tv_sec = 5,
        .tv_usec = 0,
    };

    sock = socket(AF_INET, SOCK_DGRAM, IPPROTO_UDP);
    if (sock < 0) {
        ESP_LOGE(NTP_TASK_TAG, "Create socket failed");
        return ESP_FAIL;
    }

    setsockopt(sock, SOL_SOCKET, SO_RCVTIMEO, &timeout, sizeof(timeout));

    if (sntp_resolve_hostname(hostname, &addr) != ESP_OK) {
        close(sock);
        return ESP_FAIL;
    }

    sntp_init_packet(&packet);

    if (sntp_send_and_receive(sock, &addr, &packet) != ESP_OK) {
        close(sock);
        return ESP_FAIL;
    }

    close(sock);

    uint32_t tx_sec = ntohl(packet.tx_ts_sec);
    time_t unix_time = (time_t)(tx_sec - NTP_UNIX_OFFSET);

    struct timeval tv = {
        .tv_sec = unix_time,
        .tv_usec = 0,
    };

    settimeofday(&tv, NULL);
    return ESP_OK;
}

esp_err_t sntp_request(void)
{
    for (uint8_t i = 0; i < MAX_SNTP_SERVERS; i++) {
        if (s_servernames[i][0] == '\0') {
            continue;
        }
        if (sntp_request_one(s_servernames[i]) == ESP_OK) {
            return ESP_OK;
        }
    }
    return ESP_FAIL;
}
